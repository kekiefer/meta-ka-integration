## conf/layer.conf
```bitbake
BBPATH .= ":${LAYERDIR}"
BBFILES += " \
    ${LAYERDIR}/recipes-*/*/*.bb \
    ${LAYERDIR}/recipes-*/*/*.bbappend \
"

BBFILE_COLLECTIONS += "ka-integration"
BBFILE_PATTERN_ka-integration = "^${LAYERDIR}/"
BBFILE_PRIORITY_ka-integration = "20"

LAYERVERSION_ka-integration = "1"
LAYERDEPENDS_ka-integration = "core tegra openembedded-layer meta-python"
LAYERSERIES_COMPAT_ka-integration = "nanbield"

PREFERRED_PROVIDER_tensorrt-plugins = "tensorrt-plugins"

# omegaconf needs host java to build itself, and it's not worth pulling in meta-java
HOSTTOOLS += "java"

# omegaconf (at least v2.3.0) also needs a specific antlr version that is older than the oe one
PREFERRED_VERSION_python3-antlr4-runtime = "4.9.3"
```
